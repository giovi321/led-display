// Font tables and metrics for the LED text renderer (see fonts.h).
// PURE C - no ESP-IDF, no FreeRTOS - so the host tests can compile this
// file with plain gcc.
//
// Data layout: column major, one entry per column, bit 0 = top row. The
// 7x12 font needs 12 bits per column and stores uint16_t.

#include "fonts.h"

#include <string.h>

// 5x7: compact public-domain style set, carried over from the original
// renderer. Bit 6 = bottom row; bit 7 unused.
static const uint8_t font5x7_data[95][5] = {
    {0x00,0x00,0x00,0x00,0x00}, // 0x20 ' '
    {0x00,0x00,0x5F,0x00,0x00}, // 0x21 '!'
    {0x00,0x07,0x00,0x07,0x00}, // 0x22 '"'
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    {0x08,0x04,0x08,0x10,0x08}, // 0x7E '~'
};

// 3x5: tiny font for low panels. Lowercase reuses the uppercase shapes -
// no readable lowercase exists at this size.
static const uint8_t font3x5_data[95][3] = {
    {0x00,0x00,0x00}, // 0x20 ' '
    {0x00,0x17,0x00}, // 0x21 '!'
    {0x03,0x00,0x03}, // 0x22 '"'
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    {0x02,0x06,0x04}, // 0x7E '~'
};

static const uint16_t font7x12_data[95][7] = {
    {0x000,0x000,0x000,0x000,0x000,0x000,0x000}, // 0x20 ' '
    {0x2FE,0x000,0x000,0x000,0x000,0x000,0x000}, // 0x21 '!'
    {0x00E,0x000,0x00E,0x000,0x000,0x000,0x000}, // 0x22 '"'
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    {0x020,0x010,0x010,0x020,0x020,0x010,0x000}, // 0x7E '~'
};


static const font_def_t FONTS[FONT_COUNT] = {
    [FONT_ID_5X7]  = {"5x7",  5,  7, 5, 3, font5x7_data},
    [FONT_ID_3X5]  = {"3x5",  3,  5, 3, 2, font3x5_data},
    [FONT_ID_7X12] = {"7x12", 7, 12, 6, 4, font7x12_data},
};

const font_def_t *font_get(uint8_t id)
{
    return &FONTS[id < FONT_COUNT ? id : FONT_ID_5X7];
}

int font_id_by_name(const char *name)
{
    if (!name) return -1;
    for (int i = 0; i < FONT_COUNT; i++) {
        if (strcmp(name, FONTS[i].name) == 0) return i;
    }
    return -1;
}

const char *font_name(uint8_t id)
{
    return font_get(id)->name;
}

uint8_t font_fit(uint8_t id, int max_h)
{
    if (font_get(id)->h <= max_h) return id < FONT_COUNT ? id : FONT_ID_5X7;
    int best = -1, shortest = 0;
    for (int i = 0; i < FONT_COUNT; i++) {
        if (FONTS[i].h < FONTS[shortest].h) shortest = i;
        if (FONTS[i].h <= max_h &&
            (best < 0 || FONTS[i].h > FONTS[best].h)) best = i;
    }
    return (uint8_t)(best >= 0 ? best : shortest);
}

uint16_t font_glyph_col(const font_def_t *f, char c, int col)
{
    unsigned char u = (unsigned char)c;
    if (c == FONT_THIN_SPACE) return 0;   // blank gap, never the '?' fallback
    if (u < 0x20 || u > 0x7E) u = '?';
    if (col < 0 || col >= f->w) return 0;
    unsigned gi = (unsigned)(u - 0x20) * f->w + (unsigned)col;
    if (f->h <= 8) return ((const uint8_t *)f->data)[gi];
    return ((const uint16_t *)f->data)[gi];
}

void font_glyph_span(const font_def_t *f, char c, bool prop,
                     int *start, int *width)
{
    if (c == FONT_THIN_SPACE) {
        // Narrower than ' ' in both spacing modes - even monospace, where a
        // full cell would defeat the point of the thin separator.
        *start = 0;
        *width = f->space_w > 1 ? f->space_w - 1 : 1;
        return;
    }
    if (!prop) {
        *start = 0;
        *width = f->w;
        return;
    }
    if (c >= '0' && c <= '9') {   // tabular figures: fixed advance
        *start = 0;
        *width = f->digit_w;
        return;
    }
    int first = -1, last = -1;
    for (int i = 0; i < f->w; i++) {
        if (font_glyph_col(f, c, i)) {
            if (first < 0) first = i;
            last = i;
        }
    }
    if (first < 0) {   // no set pixels: space (and space-like fallbacks)
        *start = 0;
        *width = f->space_w;
        return;
    }
    *start = first;
    *width = last - first + 1;
}

int font_text_width(const font_def_t *f, const char *s, bool prop, int scale)
{
    if (!s || !*s || scale < 1) return 0;
    int w = 0;
    for (const char *p = s; *p; p++) {
        int start, width;
        font_glyph_span(f, *p, prop, &start, &width);
        w += (width + 1) * scale;
    }
    return w - scale;   // drop the trailing gap
}
