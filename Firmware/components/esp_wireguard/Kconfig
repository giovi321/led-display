## Firmware/components/esp_wireguard/Kconfig
```kconfig
menu "WireGuard (esp_wireguard component)"

    config WIREGUARD_MAX_PEERS
        int "Maximum number of peers"
        default 1
        range 1 8
        help
            Peers are allocated statically inside the device structure to
            avoid malloc. This firmware only ever configures one peer.

    config WIREGUARD_MAX_SRC_IPS
        int "Maximum source IPs per peer"
        default 1
        range 1 8
        help
            Static allowed-ip slots per peer, in addition to the ones added
            at runtime via esp_wireguard_add_allowed_ip().

    config WIREGUARD_MAX_INIT_PER_SECOND
        int "Maximum handshake initiations per second"
        default 2
        range 1 10
        help
            Per-device rate limit on accepting valid initiation requests.

endmenu
```

## Firmware/main/Kconfig.projbuild
```kconfig
menu "LED display"

    config LEDDISP_GITHUB_REPO
        string "GitHub repo for update checks (owner/name)"
        default "giovi321/led-display"
        help
            GET /api/ota/check queries this repository's latest GitHub
            release and offers its led_display.bin asset as an OTA update.
            The repository must be public for the device to reach it.

    config LEDDISP_WIREGUARD
        bool "Compile in the WireGuard client"
        default y
        help
            Builds the vendored esp_wireguard component and the wg_client
            runtime glue. The tunnel stays down until enabled and configured
            from the web UI (Network section) or POST /api/wireguard.
            Disabling this removes the WireGuard code from the image
            entirely; the API then reports compiled_in=false.

    config LEDDISP_MQTT
        bool "Compile in the MQTT client"
        default y
        help
            Builds the mqtt_link glue on top of ESP-IDF's esp-mqtt. The
            client stays down until enabled and configured from the web UI
            (Integrations section) or POST /api/mqtt. Includes optional Home
            Assistant discovery. Disabling this removes the MQTT code from
            the image entirely; the API then reports compiled_in=false.

endmenu
```
